## components/xiaozhi_custom_wake_word/Kconfig
```kconfig
menu "Xiaozhi Custom Wake Word"

    config XIAOZHI_CUSTOM_WAKE_WORD_ENABLE
        bool "Enable custom wake word"
        default y
        help
            Use ESP-SR MultiNet voice command detection as a configurable wake word path.

    config XIAOZHI_CUSTOM_WAKE_WORD_COMMAND
        string "Wake word command"
        depends on XIAOZHI_CUSTOM_WAKE_WORD_ENABLE
        default "ni hao xiao zhi"
        help
            Pinyin command text used by MultiNet, separated by spaces.

    config XIAOZHI_CUSTOM_WAKE_WORD_DISPLAY
        string "Wake word display text"
        depends on XIAOZHI_CUSTOM_WAKE_WORD_ENABLE
        default "你好小智"
        help
            Text sent to the Xiaozhi server when the wake word is detected.

    config XIAOZHI_CUSTOM_WAKE_WORD_COMMAND_ID
        int "Wake word command id"
        depends on XIAOZHI_CUSTOM_WAKE_WORD_ENABLE
        range 0 399
        default 199
        help
            MultiNet command id reserved for the custom wake word.

    config XIAOZHI_CUSTOM_WAKE_WORD_MIN_PROB_PERCENT
        int "Minimum recognition probability percent"
        depends on XIAOZHI_CUSTOM_WAKE_WORD_ENABLE
        range 0 100
        default 0
        help
            Ignore detections below this probability. Use 0 to accept MultiNet's own threshold.

    config XIAOZHI_CUSTOM_WAKE_WORD_VCMD_TIMEOUT_MS
        int "Voice command detection timeout (ms)"
        depends on XIAOZHI_CUSTOM_WAKE_WORD_ENABLE
        range 1000 30000
        default 5000
        help
            MultiNet detection window. The app restarts detection after timeout.

endmenu
```

## main/Kconfig.projbuild
```kconfig
menu "Xiaozhi Chat Application"
    choice XIAOZHI_CHAT_APP_SERVER_BACKEND
        prompt "Chat server backend"
        default XIAOZHI_CHAT_APP_SERVER_XIAOZHI
        help
            Select the server protocol used by this firmware.

        config XIAOZHI_CHAT_APP_SERVER_XIAOZHI
            bool "Xiaozhi server"
        config XIAOZHI_CHAT_APP_SERVER_AI_TOY
            bool "AI Toy WebSocket server"
    endchoice

    menu "AI Toy WebSocket Server"
        depends on XIAOZHI_CHAT_APP_SERVER_AI_TOY

        config AI_TOY_WS_URL
            string "WebSocket URL"
            default "wss://www.haussentech.com/aiToy/ws/deviceData"
            help
                WebSocket endpoint for the AI toy platform protocol.

        config AI_TOY_DEVICE_SN
            string "Device serial number"
            default ""
            help
                Device identifier sent as deviceSn. If empty, the server may reject status and audio messages.

        config AI_TOY_WS_AUTH_TOKEN
            string "Authorization token"
            default ""
            help
                Optional token added as an Authorization header. Leave empty if the server does not require it.

        config AI_TOY_WS_RECONNECT_MS
            int "Reconnect interval (ms)"
            range 1000 60000
            default 5000

        config AI_TOY_WS_MAX_TEXT_PAYLOAD
            int "Maximum text payload size"
            range 512 16384
            default 4096
    endmenu

    # 当服务器同时下发 MQTT 和 WebSocket 参数时，决定客户端优先使用哪一种传输。
    choice XIAOZHI_CHAT_APP_TRANSPORT
        prompt "Preferred transport when both MQTT and WebSocket are supported"
        default XIAOZHI_CHAT_APP_TRANSPORT_AUTO
        depends on XIAOZHI_CHAT_APP_SERVER_XIAOZHI
        help
            When the server provides both MQTT and WebSocket, this option selects which to use.
            If "Auto (prefer MQTT)" is selected, MQTT is used when both are available.

        config XIAOZHI_CHAT_APP_TRANSPORT_AUTO
            bool "Auto (prefer MQTT)"
        config XIAOZHI_CHAT_APP_TRANSPORT_MQTT
            bool "MQTT"
        config XIAOZHI_CHAT_APP_TRANSPORT_WEBSOCKET
            bool "WebSocket"
    endchoice
endmenu
```

## sdkconfig.defaults
```kconfig
CONFIG_COMPILER_CXX_EXCEPTIONS=y
CONFIG_COMPILER_CXX_EXCEPTIONS_EMG_POOL_SIZE=1024

CONFIG_BOOTLOADER_COMPILER_OPTIMIZATION_PERF=y
CONFIG_BOOTLOADER_LOG_LEVEL_NONE=y
CONFIG_BOOTLOADER_SKIP_VALIDATE_ALWAYS=y
CONFIG_BOOTLOADER_APP_ROLLBACK_ENABLE=y

CONFIG_HTTPD_MAX_REQ_HDR_LEN=2048
CONFIG_HTTPD_MAX_URI_LEN=2048

CONFIG_PARTITION_TABLE_CUSTOM=y
CONFIG_PARTITION_TABLE_CUSTOM_FILENAME="partitions.csv"
CONFIG_PARTITION_TABLE_OFFSET=0x8000

CONFIG_ESP_TASK_WDT_TIMEOUT_S=10
CONFIG_FREERTOS_GENERATE_RUN_TIME_STATS=y
CONFIG_FREERTOS_USE_STATS_FORMATTING_FUNCTIONS=y

CONFIG_ESP_MAIN_TASK_STACK_SIZE=8192
CONFIG_MBEDTLS_DYNAMIC_BUFFER=y
CONFIG_MBEDTLS_SSL_KEEP_PEER_CERTIFICATE=n
CONFIG_ESP_WIFI_IRAM_OPT=n
CONFIG_ESP_WIFI_RX_IRAM_OPT=n
CONFIG_ESP_WIFI_DYNAMIC_RX_MGMT_BUFFER=y

# These entries are copied from ESP-HI (ESP32C3) to reduce memory usage
CONFIG_ESP_WIFI_STATIC_RX_BUFFER_NUM=6
CONFIG_ESP_WIFI_DYNAMIC_RX_BUFFER_NUM=8
CONFIG_NEWLIB_NANO_FORMAT=y
CONFIG_ESP_WIFI_ENTERPRISE_SUPPORT=n

CONFIG_CODEC_I2C_BACKWARD_COMPATIBLE=n

# Fix ML307 FIFO Overflow
CONFIG_UART_ISR_IN_IRAM=y

# LVGL 9.2.2
# Enable LVGL adapter FS so EAF assets can be mounted (esp_lv_adapter_fs_mount)
CONFIG_ESP_LVGL_ADAPTER_ENABLE_FS=y

CONFIG_LV_OS_NONE=y
CONFIG_LV_USE_OS=0
CONFIG_LV_USE_CLIB_MALLOC=y
CONFIG_LV_USE_CLIB_STRING=y
CONFIG_LV_USE_CLIB_SPRINTF=y
CONFIG_LV_USE_IMGFONT=y
CONFIG_LV_FONT_FMT_TXT_LARGE=y

# Use compressed font
CONFIG_LV_FONT_FMT_TXT_LARGE=y
CONFIG_LV_USE_FONT_COMPRESSED=y
CONFIG_LV_USE_FONT_PLACEHOLDER=y

# Enable Chinese font support (Source Han Sans SC CJK)
CONFIG_LV_FONT_SOURCE_HAN_SANS_SC_14_CJK=y
CONFIG_LV_FONT_DEFAULT_SOURCE_HAN_SANS_SC_14_CJK=y

# Disable extra widgets to save flash size
CONFIG_LV_USE_ANIMIMG=n
CONFIG_LV_USE_CALENDAR=n
CONFIG_LV_USE_CALENDAR_HEADER_ARROW=n
CONFIG_LV_USE_CALENDAR_HEADER_DROPDOWN=n
CONFIG_LV_USE_CHART=n
CONFIG_LV_USE_KEYBOARD=n
CONFIG_LV_USE_LED=n
CONFIG_LV_USE_LIST=n
CONFIG_LV_USE_MENU=n
CONFIG_LV_USE_MSGBOX=n
CONFIG_LV_USE_SPAN=n
CONFIG_LV_USE_SPINBOX=n
CONFIG_LV_USE_SPINNER=n
CONFIG_LV_USE_TABVIEW=n
CONFIG_LV_USE_TILEVIEW=n
CONFIG_LV_USE_WIN=n

CONFIG_LV_BUILD_EXAMPLES=n



CONFIG_VOICE_WAKEUP_MODE=y
CONFIG_SR_WN_WN9_NIHAOXIAOZHI_TTS=y
CONFIG_SR_WN_WN9_HILEXIN=n

# Board: esp32_s31_korvo_1
CONFIG_IDF_TARGET="esp32s31"

# Board: esp32_s31_korvo_1

# ESP Board Manager Configuration - esp32_s31_korvo_1
# Board: esp32_s31_korvo_1
CONFIG_ESP_BOARD_ESP32_S31_KORVO_1=y
CONFIG_ESP_BOARD_NAME="esp32_s31_korvo_1"
CONFIG_ESP_BOARD_PERIPH_ADC_SUPPORT=y
CONFIG_ESP_BOARD_PERIPH_GPIO_SUPPORT=y
CONFIG_ESP_BOARD_PERIPH_I2C_SUPPORT=y
CONFIG_ESP_BOARD_PERIPH_I2S_SUPPORT=y
CONFIG_ESP_BOARD_PERIPH_SPI_SUPPORT=y
CONFIG_ESP_BOARD_DEV_AUDIO_CODEC_SUPPORT=y
CONFIG_ESP_BOARD_DEV_BUTTON_SUPPORT=y
CONFIG_ESP_BOARD_DEV_CAMERA_SUPPORT=y
CONFIG_ESP_BOARD_DEV_DISPLAY_LCD_SUPPORT=y
CONFIG_ESP_BOARD_DEV_FS_FAT_SUPPORT=y
CONFIG_ESP_BOARD_DEV_LCD_TOUCH_SUPPORT=y
CONFIG_ESP_BOARD_DEV_LED_STRIP_SUPPORT=y
CONFIG_ESP_BOARD_DEV_POWER_CTRL_SUPPORT=y
CONFIG_ESP_BOARD_DEV_BUTTON_SUB_ADC_MULTI_SUPPORT=y
CONFIG_ESP_BOARD_DEV_CAMERA_SUB_DVP_SUPPORT=y
CONFIG_ESP_BOARD_DEV_DISPLAY_LCD_SUB_RGB_SUPPORT=y
CONFIG_ESP_BOARD_DEV_FS_FAT_SUB_SDMMC_SUPPORT=y
CONFIG_ESP_BOARD_DEV_LCD_TOUCH_SUB_I2C_SUPPORT=y
CONFIG_ESP_BOARD_DEV_LED_STRIP_SUB_RMT_SUPPORT=y
CONFIG_ESP_BOARD_DEV_POWER_CTRL_SUB_GPIO_SUPPORT=y

# --- Board hardware defaults (esp32_s31_korvo_1) ---
# Source: managed_components/espressif__esp_boards/esp32_s31_korvo_1/sdkconfig.defaults.board
CONFIG_ESP_DEFAULT_CPU_FREQ_MHZ_320=y
CONFIG_ESPTOOLPY_FLASHMODE_QIO=y
CONFIG_ESPTOOLPY_FLASHFREQ_80M=y
CONFIG_ESPTOOLPY_FLASHSIZE_16MB=y
CONFIG_SPIRAM=y
CONFIG_SPIRAM_MODE_OCT=y
CONFIG_SPIRAM_SPEED_80M=y

# Codec support
CONFIG_CODEC_ES8389_SUPPORT=y

# Camera
CONFIG_CAMERA_OV3660=y
CONFIG_CAM_CTRL_SPI_ENABLE=n
CONFIG_ESP_VIDEO_ENABLE_DVP_VIDEO_DEVICE=y
CONFIG_ESP_VIDEO_ENABLE_MIPI_CSI_VIDEO_DEVICE=n
CONFIG_ESP_VIDEO_ENABLE_SPI_VIDEO_DEVICE=n
CONFIG_ESP_VIDEO_ENABLE_USB_UVC_VIDEO_DEVICE=n
```
